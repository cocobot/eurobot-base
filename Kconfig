## Kconfig
```kconfig
config PLATFORM_BRAIN_2015
  bool "Brain 2015"
  #select device
  select PLATFORM_ARM_CORE_CORTEX_M4
  select USE_FPU
  select PLATFORM_DEVICE_STM32F429_439xx

	
config PLATFORM_BRAIN_2016
  bool "Brain 2016"
  #select device
  select PLATFORM_ARM_CORE_CORTEX_M4
  select USE_FPU
  select PLATFORM_DEVICE_STM32F429_439xx

config PLATFORM_PRISM_V1
  bool "Prism v1"
  #select device
  select PLATFORM_AVR_CORE
  select PLATFORM_DEVICE_ATXMEGA128A1
```

## ausbee-packages/Kconfig
```kconfig
config MCUAL
  bool "mcual"
  default n

source "$AUSBEE_CUSTOM_PACKAGES_PATH/mcual/Kconfig"

config LIBCOCOBOT
  bool "libcocobot"
  default n

source "$AUSBEE_CUSTOM_PACKAGES_PATH/libcocobot/Kconfig"

config VREP
  bool "V-Rep"
  default n

source "$AUSBEE_CUSTOM_PACKAGES_PATH/vrep/Kconfig"

config LIBCANARD
  bool "Libcanard"
  default n

source "$AUSBEE_CUSTOM_PACKAGES_PATH/libcanard/Kconfig"
```

## ausbee-packages/libcocobot/Kconfig
```kconfig
###
config LIBCOCOBOT_ASSERV
	bool "+ Asserv"
	default n
	depends on LIBCOCOBOT

config LIBCOCOBOT_DIST_RAMP_MAX_SPEED
  int " + Distance ramp - maximum speed"
  depends on LIBCOCOBOT && LIBCOCOBOT_ASSERV
  default 0

config LIBCOCOBOT_DIST_RAMP_MAX_ACCEL
  int " + Distance ramp - maximum acceleration"
  depends on LIBCOCOBOT && LIBCOCOBOT_ASSERV
  default 0

config LIBCOCOBOT_ANGU_RAMP_MAX_SPEED
  int " + Angular ramp - maximum speed"
  depends on LIBCOCOBOT && LIBCOCOBOT_ASSERV
  default 0

config LIBCOCOBOT_ANGU_RAMP_MAX_ACCEL
  int " + Angular ramp - maximum acceleration"
  depends on LIBCOCOBOT && LIBCOCOBOT_ASSERV
  default 0

config LIBCOCOBOT_DIST_PID_KP
  int " + Distance PID - Kp"
  depends on LIBCOCOBOT && LIBCOCOBOT_ASSERV
  default 0

config LIBCOCOBOT_DIST_PID_KI
  int " + Distance PID - Ki"
  depends on LIBCOCOBOT && LIBCOCOBOT_ASSERV
  default 0

config LIBCOCOBOT_DIST_PID_KD
  int " + Distance PID - Kd"
  depends on LIBCOCOBOT && LIBCOCOBOT_ASSERV
  default 0

config LIBCOCOBOT_DIST_PID_MAX_INTEGRAL
  int " + Distance PID - max integral"
  depends on LIBCOCOBOT && LIBCOCOBOT_ASSERV
  default 0

config LIBCOCOBOT_DIST_PID_MAX_ERROR_FOR_INTEGRATION
  int " + Distance PID - max error for integration"
  depends on LIBCOCOBOT && LIBCOCOBOT_ASSERV
  default 0

config LIBCOCOBOT_ANGU_PID_KP
  int " + Anguar PID - Kp"
  depends on LIBCOCOBOT && LIBCOCOBOT_ASSERV
  default 0

config LIBCOCOBOT_ANGU_PID_KI
  int " + Angular PID - Ki"
  depends on LIBCOCOBOT && LIBCOCOBOT_ASSERV
  default 0

config LIBCOCOBOT_ANGU_PID_KD
  int " + Angular PID - Kd"
  depends on LIBCOCOBOT && LIBCOCOBOT_ASSERV
  default 0

config LIBCOCOBOT_ANGU_PID_MAX_INTEGRAL
  int " + Angular PID - max integral"
  depends on LIBCOCOBOT && LIBCOCOBOT_ASSERV
  default 0

config LIBCOCOBOT_ANGU_PID_MAX_ERROR_FOR_INTEGRATION
  int " + Angular PID - max error for integration"
  depends on LIBCOCOBOT && LIBCOCOBOT_ASSERV
  default 0

config LIBCOCOBOT_LEFT_MOTOR_ALPHA
  int " + Left motor low pass filter - alpha"
  depends on LIBCOCOBOT && LIBCOCOBOT_ASSERV
  default 1000

config LIBCOCOBOT_RIGHT_MOTOR_ALPHA
  int " + Right motor low pass filter - alpha"
  depends on LIBCOCOBOT && LIBCOCOBOT_ASSERV
  default 1000

###
config LIBCOCOBOT_GAME_STATE
	bool "+ Game state"
	default n
	depends on LIBCOCOBOT

###
config LIBCOCOBOT_PATHFINDER
	bool "+ Pathfinder"
	default n
	depends on LIBCOCOBOT

choice
  prompt " + Pathfinder Table"
	depends on LIBCOCOBOT && LIBCOCOBOT_PATHFINDER
  config TABLE_2016
      bool "2016"
  config TABLE_OTHER
      bool "other"
endchoice

###
config LIBCOCOBOT_SHIFTERS
	bool "+ Shifters"
	default n
	depends on LIBCOCOBOT

###
config LIBCOCOBOT_LCD
	bool "+ LCD"
	default n
	depends on LIBCOCOBOT

###
config LIBCOCOBOT_OPPONENT_DETECTION
	bool "+ Opponent detection"
	default n
	depends on LIBCOCOBOT

###
config LIBCOCOBOT_POSITION
	bool "+ Position"
	default n
	depends on LIBCOCOBOT

config LIBCOCOBOT_POSITION_TICK_PER_180DEG
  int " + Tick / 180deg"
  depends on LIBCOCOBOT && LIBCOCOBOT_POSITION
  default 1

config LIBCOCOBOT_POSITION_TICK_PER_METER
  int " + Tick / 1m"
  depends on LIBCOCOBOT && LIBCOCOBOT_POSITION
  default 1000

choice
  prompt " + Encoder Type"
	depends on LIBCOCOBOT && LIBCOCOBOT_POSITION
  config ENCODER_SPI
      bool "spiEncoders"
  config ENCODER_QUAD
      bool "quadEncoder"
endchoice

###
config LIBCOCOBOT_ACTION_SCHEDULER
	bool "+ Action scheduler"
	default n
	depends on LIBCOCOBOT

###
config LIBCOCOBOT_TRAJECTORY
	bool "+ Trajectory"
	default n
	depends on LIBCOCOBOT

###
config LIBCOCOBOT_COM
	bool "+ COM"
	default n
	depends on LIBCOCOBOT

config LIBCOCOBOT_COM_USER_HANDLER
  bool " + Has user handler"
  depends on LIBCOCOBOT && LIBCOCOBOT_COM
	default n

config LIBCOCOBOT_COM_ID
  int " + ID of the board"
  depends on LIBCOCOBOT && LIBCOCOBOT_COM
  default 10

config LIBCOCOBOT_COM_MEMORY_POOL_SIZE
  int " + Memory pool size"
  depends on LIBCOCOBOT && LIBCOCOBOT_COM
  default 1024

config LIBCOCOBOT_COM_TIMER
  int " + Timer ID"
  depends on LIBCOCOBOT && LIBCOCOBOT_COM
  default 1

config LIBCOCOBOT_COM_USART
	bool " + USART"
	default n
	depends on LIBCOCOBOT && LIBCOCOBOT_COM

config LIBCOCOBOT_COM_CAN
	bool " + CAN"
	default n
	depends on LIBCOCOBOT && LIBCOCOBOT_COM

config LIBCOCOBOT_COM_RF
	bool " + RF"
	default n
	depends on LIBCOCOBOT && LIBCOCOBOT_COM && SPIRIT1

config LIBCOCOBOT_LOADER
	bool "+ Loader"
	default n
	depends on LIBCOCOBOT && LIBCOCOBOT_COM
```

## ausbee-packages/mcual/Kconfig
```kconfig
config MCUAL_CLOCK
	bool "+ Clock"
	default n
	depends on MCUAL

config MCUAL_GPIO
	bool "+ GPIO"
	default n
	depends on MCUAL

config MCUAL_ADC
	bool "+ ADC"
	default n
	depends on MCUAL

config MCUAL_TIMER
	bool "+ Timer"
	default n
	depends on MCUAL && MCUAL_CLOCK

comment "Timer need clock module"
depends on MCUAL && !MCUAL_CLOCK

config MCUAL_I2C
	bool "+ I2C"
	default n
	depends on MCUAL && MCUAL_CLOCK

config MCUAL_SPI
	bool "+ SPI"
	default n
	depends on MCUAL && MCUAL_CLOCK

config MCUAL_I2C_USE_FREERTOS
  bool "+ use FreeRTOS"
  depends on MCUAL_I2C
  default n

comment "I2C needs clock module"
depends on MCUAL && !MCUAL_CLOCK

config MCUAL_USART
	bool "+ USART"
	default n
	depends on MCUAL && MCUAL_CLOCK


config MCUAL_USART_USE_FREERTOS_QUEUES
  bool "+ use FreeRTOS queues"
  depends on MCUAL_USART
  default n

config MCUAL_USART_0
  bool "+ Compile USART 0"
  depends on MCUAL_USART
  default n

config MCUAL_USART_0_RX_SIZE
  int "+ USART 0 Rx buffer size"
  depends on MCUAL_USART_0
  default 8

config MCUAL_USART_0_TX_SIZE
  int "+ USART 0 Tx buffer size"
  depends on MCUAL_USART_0
  default 8

config MCUAL_USART_1
  bool "+ Compile USART 1"
  depends on MCUAL_USART
  default n

config MCUAL_USART_1_RX_SIZE
  int "+ USART 1 Rx buffer size"
  depends on MCUAL_USART_1
  default 8

config MCUAL_USART_1_TX_SIZE
  int "+ USART 1 Tx buffer size"
  depends on MCUAL_USART_1
  default 8

config MCUAL_USART_2
  bool "+ Compile USART 2"
  depends on MCUAL_USART
  default n

config MCUAL_USART_2_RX_SIZE
  int "+ USART 2 Rx buffer size"
  depends on MCUAL_USART_2
  default 8

config MCUAL_USART_2_TX_SIZE
  int "+ USART 2 Tx buffer size"
  depends on MCUAL_USART_2
  default 8

config MCUAL_USART_3
  bool "+ Compile USART 3"
  depends on MCUAL_USART
  default n

config MCUAL_USART_3_RX_SIZE
  int "+ USART 3 Rx buffer size"
  depends on MCUAL_USART_3
  default 8

config MCUAL_USART_3_TX_SIZE
  int "+ USART 3 Tx buffer size"
  depends on MCUAL_USART_3
  default 8

config MCUAL_USART_4
  bool "+ Compile USART 4"
  depends on MCUAL_USART
  default n

config MCUAL_USART_4_RX_SIZE
  int "+ USART 4 Rx buffer size"
  depends on MCUAL_USART_4
  default 8

config MCUAL_USART_4_TX_SIZE
  int "+ USART 5 Tx buffer size"
  depends on MCUAL_USART_4
  default 8

config MCUAL_USART_5
  bool "+ Compile USART 5"
  depends on MCUAL_USART
  default n

config MCUAL_USART_5_RX_SIZE
  int "+ USART 5 Rx buffer size"
  depends on MCUAL_USART_5
  default 8

config MCUAL_USART_5_TX_SIZE
  int "+ USART 5 Tx buffer size"
  depends on MCUAL_USART_5
  default 8

config MCUAL_USART_6
  bool "+ Compile USART 6"
  depends on MCUAL_USART
  default n

config MCUAL_USART_6_RX_SIZE
  int "+ USART 6 Rx buffer size"
  depends on MCUAL_USART_6
  default 8

config MCUAL_USART_6_TX_SIZE
  int "+ USART 6 Tx buffer size"
  depends on MCUAL_USART_6
  default 8

config MCUAL_USART_7
  bool "+ Compile USART 7"
  depends on MCUAL_USART
  default n

config MCUAL_USART_7_RX_SIZE
  int "+ USART 7 Rx buffer size"
  depends on MCUAL_USART_7
  default 8

config MCUAL_USART_7_TX_SIZE
  int "+ USART 7 Tx buffer size"
  depends on MCUAL_USART_7
  default 8

config MCUAL_USART_8
  bool "+ Compile USART 8"
  depends on MCUAL_USART
  default n

config MCUAL_USART_8_RX_SIZE
  int "+ USART 8 Rx buffer size"
  depends on MCUAL_USART_8
  default 8

config MCUAL_USART_8_TX_SIZE
  int "+ USART 8 Tx buffer size"
  depends on MCUAL_USART_8
  default 8

comment "USART needs clock module"
depends on MCUAL && !MCUAL_CLOCK

config MCUAL_LOADER
	bool "+ Loader"
	default n
	depends on MCUAL
```

## ausbee-packages/simulator/freeRtosPort/Kconfig
```kconfig
choice 
  prompt "Port used"
  depends on FREERTOS_HOST_PORT

config LINUX_PORT
  bool "Linux port"

config POSIX_PORT
  bool "Posix port"

endchoice
```

## ausbee-packages/vl53l0x/Kconfig
```kconfig
config VL53L0X_MAX_PERIPHERALS
  int "+ Max peripherals"
  depends on VL53L0X
  default 3
```

## ausbee-platforms/Kconfig
```kconfig
config PLATFORM_BRAIN_2019
  bool "Brain 2019"
  #select device
  select PLATFORM_ARM_CORE_CORTEX_M4
  select USE_FPU
  select PLATFORM_DEVICE_STM32F429_439xx

config PLATFORM_MECANELE_2019
  bool "Mecanele 2019"
  #select device
  select PLATFORM_ARM_CORE_CORTEX_M4
  select USE_FPU
  select PLATFORM_DEVICE_STM32F429_439xx

config PLATFORM_COM_2019
  bool "Com 2019"
  #select device
  select PLATFORM_ARM_CORE_CORTEX_M4
  select USE_FPU
  select PLATFORM_DEVICE_STM32F429_439xx

config PLATFORM_CANON_2019
  bool "Canon 2019"
  #select device
  select PLATFORM_ARM_CORE_CORTEX_M4
  select USE_FPU
  select PLATFORM_DEVICE_STM32F496xx
```

## ausbee-platforms/canivo_2019/Kconfig
```kconfig
config PLATFORM_CANIVO_2019_UART
  bool " + canivo 2019 UART"
  default n
  depends on PLATFORM_CANIVO_2019
```

## ausbee-platforms/com_2019/Kconfig
```kconfig
config PLATFORM_COM_2019_USB
  bool " + com 2019 USB"
  default n
  depends on PLATFORM_COM_2019
config PLATFORM_COM_2019_CAN
  bool " + com 2019 CAN"
  default n
  depends on PLATFORM_COM_2019
```
